.dw 0x2237, 0x0A8F, 0x0039, 0x088F, 0x2239, 0x2231, 0x023D
.dw 0x2236, 0x0889, 0x001e, 0x2530, 0x0038, 0x0176, 0x0476
.dw 0x003F, 0x2233, 0x043F, 0x2633, 0x024D, 0x0881, 0x003E
.dw 0x1130, 0x1436, 0x1540, 0x0940, 0x1109

; A: 0x10001000110111
; B: 0x00101010001111
; C: 0x00000000111001
; D: 0x00100010001111
; E: 0x10001000111001
; F: 0x10001000110001
; G: 0x00001000111101

; H: 0010001000110110
; I: 0000100010001001
; J: 0000000000011110
; K: 0010010100110000
; L: 0000000000111000
; M: 0000000101110110
; N: 0000010001110110

; O: 0x00000000111111
; P: 0x10001000110011
; Q: 0x00010000111111
; R: 0x10011000110011
; S: 0x00001001001101
; T: 0x00100010000001

; U: 0x00000000111110
; V: 0x01000100110000
; W: 0x01010000110110
; X: 0x01010101000000
; Y: 0x00100101000000
; Z: 0x01000100001001
